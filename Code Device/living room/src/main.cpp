#include <WiFi.h>
#include <WiFiClient.h>
#include <WiFiManager.h>
#include <HTTPClient.h>
#include <ESP32httpUpdate.h>

#include <Servo.h>

#include <esp_now.h>

#include <SPI.h>
#include <Adafruit_GFX.h>
#include <Adafruit_PCD8544.h>

//const char* currentVersion = "1.0";
//const char* serverUrl = "http://192.168.1.35:3000/room1/firmware.bin";

Servo myservo;  // create servo object to control a servo

/* Declare LCD object for SPI */
Adafruit_PCD8544 display = Adafruit_PCD8544(18, 23, 4, 15, 2);
int contrastValue = 60; // Default Contrast Value

// Logo One Piece (84x48 bitmap)
const unsigned char logo [] PROGMEM = {
	0x00, 0x00, 0x00, 0x00, 0x00, 0x00, 0x00, 0x00, 0x00, 0x00, 0x00, 0x00, 0x00, 0x00, 0x00, 0x00, 
	0x00, 0x00, 0x00, 0x00, 0x00, 0x00, 0x00, 0x00, 0x00, 0x00, 0x00, 0x00, 0x00, 0x00, 0x00, 0x00, 
	0x00, 0x00, 0x00, 0x00, 0x00, 0x00, 0x00, 0x00, 0x00, 0x00, 0x00, 0x00, 0x00, 0x00, 0x00, 0x00, 
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	0x00, 0x00, 0x00, 0x00, 0x00, 0x00, 0x00, 0x00, 0x00, 0x00, 0x00, 0x00, 0x00, 0x00, 0x00, 0x00
};

// REPLACE WITH THE MAC Address of your receiver 48:55:19:E4:FB:CF (esp8266)
uint8_t broadcastAddress[] = {0x48, 0x55, 0x19, 0xE4, 0xFB, 0xCF};

#define ledR 19
#define ledY 21

// Define variables to store incoming readings
int incomingLed;
int incomingDoor;
float incomingTemp;
float incomingHum;
int incomingGas;

// Variable to store if sending data was successful
String success;

//Structure example to send data
//Must match the receiver structure
typedef struct struct_message {
  float temp;
  float hum;
  int gas;
  int motion;
  int led2;
  int led3;
  int door3;
  int led4;
} struct_message;

// Create a struct_message called sendingReadings to hold sensor readings
struct_message sendingReadings;

// Create a struct_message to hold incoming sensor readings
struct_message incomingReadings;

unsigned long lastTime = 0;  
unsigned long timerDelay = 2000;  // send readings timer

esp_now_peer_info_t peerInfo;

// Callback when data is sent
void OnDataSent(const uint8_t *mac_addr, esp_now_send_status_t status) {
  Serial.print("\r\nLast Packet Send Status:\t");
  Serial.println(status == ESP_NOW_SEND_SUCCESS ? "Delivery Success" : "Delivery Fail");
  if (status ==0){
    success = "Delivery Success :)";
  }
  else{
    success = "Delivery Fail :(";
  }
}

// Callback when data is received
void OnDataRecv(const uint8_t * mac, const uint8_t *incomingData, int len) {
  memcpy(&incomingReadings, incomingData, sizeof(incomingReadings));
  Serial.print("Bytes received: ");
  Serial.println(len);
  incomingLed = incomingReadings.led4;
  incomingDoor = incomingReadings.door3;
  incomingGas = incomingReadings.gas;
  incomingTemp = incomingReadings.temp;
  incomingHum = incomingReadings.hum;
}

void serialDisplay(){  
  // Display Readings in Serial Monitor
  Serial.println("INCOMING READINGS");
  Serial.print("Temperature: ");
  Serial.print(incomingTemp);
  Serial.println(" ºC");
  Serial.print("Humidity: ");
  Serial.print(incomingHum);
  Serial.println(" %");
  Serial.print("Gas: ");
  Serial.println(incomingGas);
  Serial.print("Led: ");
  Serial.println(incomingLed);
  Serial.print("Door: ");
  Serial.println(incomingDoor);
  Serial.println();
}

void setup()
{
  // Init Serial Monitor
  Serial.begin(115200);
  Serial.println();
  Serial.println();
/*
  // Connect Wifi
  WiFiManager wm;
  bool res;
  res = wm.autoConnect("AutoConnectAP","password");
  if(!res) {
      Serial.println("Failed to connect");
  } 
  else { 
      Serial.println("connected...yeey :)");
  }

  // httpUpdate
  Serial.print("ESP32 http update, current version: ");
  Serial.println(currentVersion);

  t_httpUpdate_return ret = ESPhttpUpdate.update(serverUrl, currentVersion);

  switch(ret) {
    case HTTP_UPDATE_FAILED:
      Serial.printf("HTTP_UPDATE_FAILD Error (%d): %s", ESPhttpUpdate.getLastError(), ESPhttpUpdate.getLastErrorString().c_str());
      break;

    case HTTP_UPDATE_NO_UPDATES:
      Serial.println("HTTP_UPDATE_NO_UPDATES");
      break;
    case HTTP_UPDATE_OK:
      Serial.println("HTTP_UPDATE_OK");
      break;
  }
*/
  pinMode(ledR, OUTPUT); 
  pinMode(ledY, OUTPUT);

  myservo.attach(13);  // attaches the servo on pin 13 to the servo object
 
  // Set device as a Wi-Fi Station
  WiFi.mode(WIFI_STA);

  // Init ESP-NOW
  if (esp_now_init() != ESP_OK) {
    Serial.println("Error initializing ESP-NOW");
    return;
  }

  // Once ESPNow is successfully Init, we will register for Send CB to
  // get the status of Trasnmitted packet
  esp_now_register_send_cb(OnDataSent);
  
  // Register peer
  memcpy(peerInfo.peer_addr, broadcastAddress, 6);
  peerInfo.channel = 0;  
  peerInfo.encrypt = false;
  
  // Add peer        
  if (esp_now_add_peer(&peerInfo) != ESP_OK){
    Serial.println("Failed to add peer");
    return;
  }
  // Register for a callback function that will be called when data is received
  esp_now_register_recv_cb(OnDataRecv);

  /* Initialize the Display */
  display.begin();

  /* Change the contrast using the following API */
  display.setContrast(contrastValue);

  /* Set up PWM for backlight control */
  analogWrite(5, 100);  // Set backlight

  /* Clear the buffer */
  display.clearDisplay();
  display.display();
  delay(1000);

  /* Display the logo */
  display.drawBitmap(0, 0, logo, 84, 48, BLACK); // Điều chỉnh vị trí xuất phát của logo

  /* Display the content */
  display.display();
  delay(2000);

}

void loop()
{
  if((millis() - lastTime) > timerDelay){
	  // Send message via ESP-NOW
    esp_err_t result = esp_now_send(broadcastAddress, (uint8_t *) &sendingReadings, sizeof(sendingReadings));
   
    if (result == ESP_OK) {
      Serial.println("Sent with success");
    }
    else {
      Serial.println("Error sending the data");
    }
    serialDisplay();
    
    analogWrite(ledY, 255 - incomingLed);

    // increase the LED brightness
    if (incomingGas >= 100){
      for(int dutyCycle = 0; dutyCycle < 255; dutyCycle++){   
      // changing the LED brightness with PWM
        analogWrite(ledR, dutyCycle);    
      }
    }

    if(incomingDoor == 1){
      myservo.write(30); //mo
    }
    else if(incomingDoor == 0){
      myservo.write(120); //dong
    }

    lastTime = millis();
  }
}
